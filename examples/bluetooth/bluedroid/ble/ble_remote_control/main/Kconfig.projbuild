## examples/bluetooth/esp_ble_mesh/ble_mesh_ota/tcp_method/ota_ap_sender/main/Kconfig.projbuild
```kconfig
menu "Example Configuration"
    
    menu "SoftAP configuration"
        comment "STA Configuration"

        config ESP_WIFI_SOFT_AP_SSID
            string "WiFi SSID"
            default "myssid"
            help
                SSID (network name) for the example to connect to.

        config ESP_WIFI_SOFT_AP_PASSWORD
            string "WiFi Password"
            default "mypassword"
            help
                WiFi password (WPA or WPA2) for the example to use.

        config ESP_WIFI_SOFT_AP_CHANNEL
            int "WiFi Channel"
            range 1 13
            default 1
            help
                WiFi channel (network channel) for the example to use.

        config ESP_MAX_STA_CONN
            int "Maximal STA connections"
            default 4
            help
                Max number of the STA connects to AP.

        config EXAMPLE_PORT
            int "Port"
            range 0 65535
            default 3333
            help
                Local port the example server will listen on.

        config EXAMPLE_KEEPALIVE_IDLE
            int "TCP keep-alive idle time(s)"
            default 5
            help
                Keep-alive idle time. In idle time without receiving any data from peer, will send keep-alive probe packet

        config EXAMPLE_KEEPALIVE_INTERVAL
            int "TCP keep-alive interval time(s)"
            default 5
            help
                Keep-alive probe packet interval time.

        config EXAMPLE_KEEPALIVE_COUNT
            int "TCP keep-alive packet retry send counts"
            default 3
            help
                Keep-alive probe packet retry count.
    endmenu
    
    menu "STA Configuration"
        comment "STA Configuration"

        config ESP_WIFI_REMOTE_AP_SSID
            string "WiFi Remote AP SSID"
            default "otherapssid"
            help
                SSID (network name) for the example's sta to connect to.

        config ESP_WIFI_REMOTE_AP_PASSWORD
            string "WiFi Remote AP Password"
            default "otherappassword"
            help
                WiFi password for the example to use.

        config ESP_MAXIMUM_STA_RETRY
            int "Maximum retry"
            default 5
            help
                Set the maximum retry value to prevent the station from continuously
                attempting to reconnect to the Access Point (AP) when the AP doesn't exist.

        choice ESP_WIFI_SCAN_AUTH_MODE_THRESHOLD
            prompt "WiFi Scan auth mode threshold"
            default ESP_WIFI_AUTH_WPA2_PSK
            help
                The weakest authmode to accept in the scan mode.
                This value defaults to ESP_WIFI_AUTH_WPA2_PSK incase password is present
                and ESP_WIFI_AUTH_OPEN is used. Please select ESP_WIFI_AUTH_WEP / ESP_WIFI_AUTH_WPA_PSK
                incase AP is operating in WEP / WPA mode.

            config ESP_WIFI_AUTH_OPEN
                bool "OPEN"
            config ESP_WIFI_AUTH_WEP
                bool "WEP"
            config ESP_WIFI_AUTH_WPA_PSK
                bool "WPA PSK"
            config ESP_WIFI_AUTH_WPA2_PSK
                bool "WPA2 PSK"
            config ESP_WIFI_AUTH_WPA_WPA2_PSK
                bool "WPA/WPA2 PSK"
            config ESP_WIFI_AUTH_WPA3_PSK
                bool "WPA3 PSK"
            config ESP_WIFI_AUTH_WPA2_WPA3_PSK
                bool "WPA2/WPA3 PSK"
            config ESP_WIFI_AUTH_WAPI_PSK
                bool "WAPI PSK"
        endchoice

    endmenu

endmenu
```

## examples/bluetooth/esp_ble_mesh/ble_mesh_ota/wifi_dist_method/ota_client/main/Kconfig.projbuild
```kconfig
menu "Example Task Configuration"

    config EXAMPLE_BOARD_BUTTON_GPIO
        int "Boot Button GPIO"
        default 9 if IDF_TARGET_ESP32C3 || IDF_TARGET_ESP32C6
        default 0
        help
            GPIO number on which the "Boot" button is connected. This is generally used
            by the application for custom operations like toggling states, resetting to defaults, etc.


    config EXAMPLE_WIFI_CRED_FROM_STDIN
        bool "WiFi credentials from stdin"
        default n
        help
            If enabled, WiFi credentials will be read from stdin.

    config EXAMPLE_WIFI_SSID
        string "WiFi SSID"
        default "myssid"
        depends on !EXAMPLE_WIFI_CRED_FROM_STDIN
        help
          WiFi SSID to connect to
        
    config EXAMPLE_WIFI_PASSWORD
        string "WiFi Password"
        default "mypassword"
        depends on !EXAMPLE_WIFI_CRED_FROM_STDIN
        help
          WiFi password to use

    config EXAMPLE_OTA_INFO_FROM_STDIN
        bool "OTA URL from stdin"
        default n
        help
            If enabled, OTA URL will be read from stdin.

    config EXAMPLE_OTA_URL
        string "OTA URL"
        default "https://127.0.0.1:8070/ble_mesh_ota.bin"
        depends on !EXAMPLE_OTA_INFO_FROM_STDIN
        help
          OTA URL to use
        
    config EXAMPLE_OTA_SIZE
        int "OTA Size"
        default 0
        depends on !EXAMPLE_OTA_INFO_FROM_STDIN
        help
          Size of OTA image to download, cannot be 0

endmenu


menu "Example Wifi Configuration"
    choice EXAMPLE_WIFI_SCAN_METHOD
        prompt "WiFi Scan Method"
        default EXAMPLE_WIFI_SCAN_METHOD_ALL_CHANNEL
        help
            WiFi scan method:

            If "Fast" is selected, scan will end after find SSID match AP.

            If "All Channel" is selected, scan will end after scan all the channel.

        config EXAMPLE_WIFI_SCAN_METHOD_FAST
            bool "Fast"
        config EXAMPLE_WIFI_SCAN_METHOD_ALL_CHANNEL
            bool "All Channel"
    endchoice

    choice EXAMPLE_WIFI_CONNECT_AP_SORT_METHOD
        prompt "WiFi Connect AP Sort Method"
        default EXAMPLE_WIFI_CONNECT_AP_BY_SIGNAL
        help
            WiFi connect AP sort method:

            If "Signal" is selected, Sort matched APs in scan list by RSSI.

            If "Security" is selected, Sort matched APs in scan list by security mode.

        config EXAMPLE_WIFI_CONNECT_AP_BY_SIGNAL
            bool "Signal"
        config EXAMPLE_WIFI_CONNECT_AP_BY_SECURITY
            bool "Security"
    endchoice

    menu "WiFi Scan threshold"
        config EXAMPLE_WIFI_SCAN_RSSI_THRESHOLD
            int "WiFi minimum rssi"
            range -127 0
            default -127
            help
                The minimum rssi to accept in the scan mode.

        choice EXAMPLE_WIFI_SCAN_AUTH_MODE_THRESHOLD
            prompt "WiFi Scan auth mode threshold"
            default EXAMPLE_WIFI_AUTH_WPA2_PSK
            help
                The weakest authmode to accept in the scan mode.

            config EXAMPLE_WIFI_AUTH_OPEN
                bool "OPEN"
            config EXAMPLE_WIFI_AUTH_WEP
                bool "WEP"
            config EXAMPLE_WIFI_AUTH_WPA_PSK
                bool "WPA PSK"
            config EXAMPLE_WIFI_AUTH_WPA2_PSK
                bool "WPA2 PSK"
            config EXAMPLE_WIFI_AUTH_WPA_WPA2_PSK
                bool "WPA WPA2 PSK"
            config EXAMPLE_WIFI_AUTH_WPA2_ENTERPRISE
                bool "WPA2 ENTERPRISE"
            config EXAMPLE_WIFI_AUTH_WPA3_PSK
                bool "WPA3 PSK"
            config EXAMPLE_WIFI_AUTH_WPA2_WPA3_PSK
                bool "WPA2 WPA3 PSK"
            config EXAMPLE_WIFI_AUTH_WAPI_PSK
                bool "WAPI PSK"
        endchoice
    endmenu

    config EXAMPLE_WIFI_CONN_MAX_RETRY
        int "Maximum retry"
        default 6
        help
            Set the Maximum retry to avoid station reconnecting to the AP unlimited,
            in case the AP is really inexistent.

endmenu
```

## examples/bluetooth/esp_ble_mesh/ble_mesh_ota/wifi_dist_method/ota_server/sdkconfig.defaults
```kconfig
# Espressif IoT Development Framework (ESP-IDF) Project Minimal Configuration
            
# PARTITION TABLE
# custom partition table
CONFIG_ESPTOOLPY_FLASHSIZE_8MB=y
CONFIG_PARTITION_TABLE_TWO_OTA=y
CONFIG_PARTITION_TABLE_CUSTOM=y
CONFIG_PARTITION_TABLE_CUSTOM_FILENAME="partitions.csv"
CONFIG_PARTITION_TABLE_FILENAME="partitions.csv"
CONFIG_PARTITION_TABLE_OFFSET=0x8000
CONFIG_PARTITION_TABLE_MD5=y


# WIFI
CONFIG_ESP_WIFI_ENABLED=y

#
# ESP HTTPS OTA
#
CONFIG_OTA_ALLOW_HTTP=y

# BLUETOOTH 
# enable BT and BLE support
# PB_GATT to enable
CONFIG_BT_ENABLED=y
CONFIG_BT_GATTS_SEND_SERVICE_CHANGE_MANUAL=y
CONFIG_BT_BLE_50_FEATURES_SUPPORTED=y
CONFIG_BT_BLE_42_FEATURES_SUPPORTED=y
CONFIG_BLE_MESH=y
CONFIG_BLE_MESH_PROV=y
CONFIG_BLE_MESH_PB_GATT=y
CONFIG_BLE_MESH_NODE=y

# OTA
CONFIG_BT_CTRL_BLE_MESH_SCAN_DUPL_EN=y
```
