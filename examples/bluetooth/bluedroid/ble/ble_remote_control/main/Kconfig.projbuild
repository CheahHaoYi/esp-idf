## examples/bluetooth/bluedroid/ble/ble_remote_control/main/Kconfig.projbuild
```kconfig
menu "Example Configuration"

    config EXAMPLE_BOARD_BUTTON_GPIO
        int "Boot Button GPIO"
        default 0 if !IDF_TARGET_ESP32C3
        default 9 if IDF_TARGET_ESP32C3
        help
            GPIO number on which the "Boot" button is connected. This is generally used
            by the application for custom operations like toggling states, resetting to defaults, etc.
    
    choice JOYSTICK_INPUT_MODE
        prompt "Joystick Input Mode"
        default JOYSTICK_INPUT_MODE_ADC
        help
            Select the mode of joystick input.
        
        config JOYSTICK_INPUT_MODE_ADC
            bool "ADC"
            help
                Use ADC to read joystick input, using external hardware
        
        config JOYSTICK_INPUT_MODE_CONSOLE
            bool "Console"
            help
                Read from console to emulate joystick input.
    endchoice

    choice BUTTON_INPUT_MODE
        prompt "Button Input Mode"
        default BUTTON_INPUT_MODE_BOOT
        help
            Select the mode of button input.

        config BUTTON_INPUT_MODE_GPIO
            bool "GPIO"
            help
                Use GPIO to read button input, using external hardware
        
        config BUTTON_INPUT_MODE_BOOT
            bool "Boot"
            help
                Use boot button as button input.

    endchoice

    config EXAMPLE_ENABLE_TEAR_DOWN_DEMO
        bool "Demo Tear Down"
        depends on BUTTON_INPUT_MODE_GPIO
        default n
        help
            Enable this option to demonstrate tear down when the tear down button bitmask combination is pressed.
            Need external buttons with pull-up resistors connected to GPIOs.

endmenu
```

## examples/bluetooth/esp_ble_mesh/ble_mesh_ota/ble_mesh_app/main/Kconfig.projbuild
```kconfig
menu "BLE Mesh APP Example Configuration"

    choice BLE_MESH_EXAMPLE_BOARD
        prompt "Board selection for BLE Mesh"
        default BLE_MESH_ESP_WROOM_32
        help
            Select this option to choose the board for BLE Mesh. The default is ESP32-WROOM-32

        config BLE_MESH_ESP_WROOM_32
            bool "ESP32-WROOM-32"

        config BLE_MESH_ESP_WROVER
            bool "ESP32-WROVER"
    endchoice

    config BLE_MESH_PATCH_FOR_SLAB_APP_1_1_0
        bool "Fix bug of Silicon Lab Android App v1.1.0 when reconnection will cause sequence number to recount from 0"
        default y
        help
            It is an ad hoc solution and needs further modifications

    menu "light driver config"
        config LIGHT_GPIO_RED
            int "Light red pin GPIO number"
            range 0 33
            default 25
            help
                There are more enumerations like that
                up to GPIO39, excluding GPIO20, GPIO24 and GPIO28..31.
                They are not shown here to reduce redundant information.
                @note GPIO34..39 are input mode only.

        config LIGHT_GPIO_GREEN
            int "Light green pin GPIO number"
            range 0 33
            default 26
            help
                There are more enumerations like that
                up to GPIO39, excluding GPIO20, GPIO24 and GPIO28..31.
                They are not shown here to reduce redundant information.
                @note GPIO34..39 are input mode only.

        config LIGHT_GPIO_BLUE
            int "Light blue pin GPIO number"
            range 0 33
            default 27
            help
                There are more enumerations like that
                up to GPIO39, excluding GPIO20, GPIO24 and GPIO28..31.
                They are not shown here to reduce redundant information.
                @note GPIO34..39 are input mode only.

        config LIGHT_GPIO_COLD
            int "Light cold colors pin GPIO number"
            range 0 33
            default 23
            help
                There are more enumerations like that
                up to GPIO39, excluding GPIO20, GPIO24 and GPIO28..31.
                They are not shown here to reduce redundant information.
                @note GPIO34..39 are input mode only.

        config LIGHT_GPIO_WARM
            int "Light warm color pin GPIO number"
            range 0 33
            default 19
            help
                There are more enumerations like that
                up to GPIO39, excluding GPIO20, GPIO24 and GPIO28..31.
                They are not shown here to reduce redundant information.
                @note GPIO34..39 are input mode only.

        config LIGHT_FADE_PERIOD_MS
            int "The time from the current color to the next color"
            default 500
            help
                The time from the current color to the next color.

        config LIGHT_BLINK_PERIOD_MS
            int "Period of blinking lights"
            default 2000
            help
                Period of blinking lights.
    endmenu

    config LIGHT_VERSION
        string "Light version"
        default "1.2.2"
        help
            Version of the five-color light

    config LIGHT_MEMORY_DEBUG
        bool "Enable memory debugging"
        default n
        help
            Enable memory debugging.

    config LIGHT_RESTART_COUNT_RESET
        int "Reset the number of times the device has been powered off continuously to enter the configured network mode"
        range 3 10
        default 3
        help
            Reset the number of times the device has been powered off continuously to enter the configured network mode.

    config LIGHT_RESTART_COUNT_ROLLBACK
        int "Number of times the device restarted abnormally, entered, and exited from the previous version"
        range 5 32
        default 10
        help
            Number of times the device restarted abnormally, entered, and exited from the previous version.

    config UPGRADE_VERSION_ROLLBACK_RESTART
        bool "Fall back to the previous version"
        default y
        help
            If there is a factory partition, it will switch to the factory partition.

    config UPGRADE_VERSION_ROLLBACK_RESTART_COUNT
        int "How many times to restart continuously will rollback"
        range 15 32
        default 15
        depends on UPGRADE_VERSION_ROLLBACK_RESTART
        help
            How many times to restart continuously will rollback.

    config UPGRADE_VERSION_ROLLBACK_RESTART_TIMEOUT
        int "Continuous restart interval(ms)"
        default 5000
        depends on UPGRADE_VERSION_ROLLBACK_RESTART
        help
            Continuous restart interval.

    config UPGRADE_VERSION_ROLLBACK_FACTORY
        bool "If there is a factory partition, fall back to the factory version"
        default y
        depends on UPGRADE_VERSION_ROLLBACK_RESTART
        help
            If there is a factory partition, fall back to the factory version instead
            of rolling back to the previous version

endmenu
```

## examples/bluetooth/esp_ble_mesh/ble_mesh_ota/ble_mesh_app/sdkconfig.defaults
```kconfig
# Override some defaults so BT stack is enabled
# by default in this example
CONFIG_BT_ENABLED=y
CONFIG_BTDM_CTRL_MODE_BLE_ONLY=y
CONFIG_BTDM_CTRL_MODE_BR_EDR_ONLY=n
CONFIG_BTDM_CTRL_MODE_BTDM=n
CONFIG_BTDM_MODEM_SLEEP=n
CONFIG_BTDM_SCAN_DUPL_TYPE_DATA_DEVICE=y
CONFIG_BTDM_BLE_MESH_SCAN_DUPL_EN=y
CONFIG_BT_GATTS_SEND_SERVICE_CHANGE_MANUAL=y
CONFIG_BT_BTU_TASK_STACK_SIZE=4512

#
# Partition Table
#
CONFIG_PARTITION_TABLE_CUSTOM=y
CONFIG_PARTITION_TABLE_CUSTOM_FILENAME="partitions.csv"
CONFIG_PARTITION_TABLE_FILENAME="partitions.csv"
# end of Partition Table
#
# Serial flasher config
#
CONFIG_ESPTOOLPY_FLASHSIZE_4MB=y

# Override some defaults of ESP BLE Mesh
CONFIG_BLE_MESH=y
CONFIG_BLE_MESH_FAST_PROV=y
CONFIG_BLE_MESH_MAX_PROV_NODES=6
CONFIG_BLE_MESH_NODE=y
CONFIG_BLE_MESH_PB_GATT=y
CONFIG_BLE_MESH_TX_SEG_MSG_COUNT=10
CONFIG_BLE_MESH_RX_SEG_MSG_COUNT=10
CONFIG_BLE_MESH_SETTINGS=y
CONFIG_BLE_MESH_CFG_CLI=y
CONFIG_BLE_MESH_ADV_BUF_COUNT=120
CONFIG_BLE_MESH_SPECIFIC_PARTITION=y
CONFIG_BLE_MESH_PARTITION_NAME="ble_mesh"

CONFIG_FREERTOS_TIMER_TASK_STACK_DEPTH=4096

#
# ESP HTTPS OTA
#
CONFIG_OTA_ALLOW_HTTP=y
# end of ESP HTTPS OTA

#
# Serial flasher config
#
CONFIG_ESPTOOLPY_FLASHMODE_QIO=y
CONFIG_ESPTOOLPY_FLASHFREQ_80M=y

#
# ESP32-specific
#
CONFIG_ESP32_ENABLE_COREDUMP=y
CONFIG_ESP32_ENABLE_COREDUMP_TO_FLASH=y
CONFIG_ESP_TASK_WDT=y
CONFIG_ESP_TASK_WDT_PANIC=y
CONFIG_ESP_TASK_WDT_TIMEOUT_S=30
```

## examples/bluetooth/esp_ble_mesh/ble_mesh_ota/common_components/example_ota/Kconfig
```kconfig
menu "BLE MESH OTA"

    config BLE_MESH_OTA_SEGMENT_SIZE
        int "Size of each BLE Mesh OTA segment to be sent"
        range 128 4096
        default 1024
        help
            Size of each BLE MESH OTA segment to be transmitted.

endmenu
```

## examples/bluetooth/esp_ble_mesh/ble_mesh_ota/ota_client/main/Kconfig.projbuild
```kconfig
menu "Example Task Configuration"

    config EXAMPLE_WIFI_CRED_FROM_STDIN
        bool "WiFi credentials from stdin"
        default n
        help
            If enabled, WiFi credentials will be read from stdin.

    config EXAMPLE_WIFI_SSID
        string "WiFi SSID"
        default "myssid"
        depends on !EXAMPLE_WIFI_CRED_FROM_STDIN
        help
          WiFi SSID to connect to
        
    config EXAMPLE_WIFI_PASSWORD
        string "WiFi Password"
        default "mypassword"
        depends on !EXAMPLE_WIFI_CRED_FROM_STDIN
        help
          WiFi password to use

    config EXAMPLE_OTA_URL_FROM_STDIN
        bool "OTA URL from stdin"
        default n
        help
            If enabled, OTA URL will be read from stdin.

    config EXAMPLE_OTA_URL
        string "OTA URL"
        default "https://127.0.0.1:8070/ble_mesh_ota_bin"
        depends on !EXAMPLE_OTA_URL_FROM_STDIN
        help
          OTA URL to use
        
    config EXAMPLE_OTA_SIZE
        int "OTA Size"
        default 0
        help
          Size of OTA image to download, cannot be 0

endmenu
```

## examples/bluetooth/esp_ble_mesh/ble_mesh_ota/ota_server/main/Kconfig.projbuild
```kconfig
menu "Example Task Configuration"

    orsource "$IDF_PATH/examples/common_components/env_caps/$IDF_TARGET/Kconfig.env_caps"

    config BLINK_GPIO
        int "Blink GPIO number"
        range ENV_GPIO_RANGE_MIN ENV_GPIO_OUT_RANGE_MAX
        default 5 if IDF_TARGET_ESP32
        default 18 if IDF_TARGET_ESP32S2
        default 48 if IDF_TARGET_ESP32S3
        default 8
        help
            GPIO number (IOxx) to blink on and off or the RMT signal for the addressable LED.
            Some GPIOs are used for other purposes (flash connections, etc.) and cannot be used to blink.

    config OTA_VERSION
        int "OTA Version"
        range 1 4
        default 1
        help 
            Example to show changes in OTA version

endmenu

menu "Example Wifi Configuration"
    choice EXAMPLE_WIFI_SCAN_METHOD
        prompt "WiFi Scan Method"
        default EXAMPLE_WIFI_SCAN_METHOD_ALL_CHANNEL
        help
            WiFi scan method:

            If "Fast" is selected, scan will end after find SSID match AP.

            If "All Channel" is selected, scan will end after scan all the channel.

        config EXAMPLE_WIFI_SCAN_METHOD_FAST
            bool "Fast"
        config EXAMPLE_WIFI_SCAN_METHOD_ALL_CHANNEL
            bool "All Channel"
    endchoice

    choice EXAMPLE_WIFI_CONNECT_AP_SORT_METHOD
        prompt "WiFi Connect AP Sort Method"
        default EXAMPLE_WIFI_CONNECT_AP_BY_SIGNAL
        help
            WiFi connect AP sort method:

            If "Signal" is selected, Sort matched APs in scan list by RSSI.

            If "Security" is selected, Sort matched APs in scan list by security mode.

        config EXAMPLE_WIFI_CONNECT_AP_BY_SIGNAL
            bool "Signal"
        config EXAMPLE_WIFI_CONNECT_AP_BY_SECURITY
            bool "Security"
    endchoice

    menu "WiFi Scan threshold"
        config EXAMPLE_WIFI_SCAN_RSSI_THRESHOLD
            int "WiFi minimum rssi"
            range -127 0
            default -127
            help
                The minimum rssi to accept in the scan mode.

        choice EXAMPLE_WIFI_SCAN_AUTH_MODE_THRESHOLD
            prompt "WiFi Scan auth mode threshold"
            default EXAMPLE_WIFI_AUTH_WPA2_PSK
            help
                The weakest authmode to accept in the scan mode.

            config EXAMPLE_WIFI_AUTH_OPEN
                bool "OPEN"
            config EXAMPLE_WIFI_AUTH_WEP
                bool "WEP"
            config EXAMPLE_WIFI_AUTH_WPA_PSK
                bool "WPA PSK"
            config EXAMPLE_WIFI_AUTH_WPA2_PSK
                bool "WPA2 PSK"
            config EXAMPLE_WIFI_AUTH_WPA_WPA2_PSK
                bool "WPA WPA2 PSK"
            config EXAMPLE_WIFI_AUTH_WPA2_ENTERPRISE
                bool "WPA2 ENTERPRISE"
            config EXAMPLE_WIFI_AUTH_WPA3_PSK
                bool "WPA3 PSK"
            config EXAMPLE_WIFI_AUTH_WPA2_WPA3_PSK
                bool "WPA2 WPA3 PSK"
            config EXAMPLE_WIFI_AUTH_WAPI_PSK
                bool "WAPI PSK"
        endchoice
    endmenu

    config EXAMPLE_WIFI_CONN_MAX_RETRY
        int "Maximum retry"
        default 6
        help
            Set the Maximum retry to avoid station reconnecting to the AP unlimited,
            in case the AP is really inexistent.

endmenu

menu "Example OTA Configuration"

    config EXAMPLE_FIRMWARE_UPGRADE_URL
        string "firmware upgrade url endpoint"
        default "https://127.0.0.1:8070/ble_mesh_ota.bin"
        help
            URL of server which hosts the firmware image.

    config EXAMPLE_USE_CERT_BUNDLE
        bool "Enable certificate bundle"
        default n
        depends on MBEDTLS_CERTIFICATE_BUNDLE
        help
            Enable trusted root certificate bundle. This approach allows to have
            OTA updates functional with any public server without requirement
            to explicitly add its server certificate.

    config EXAMPLE_SKIP_COMMON_NAME_CHECK
        bool "Skip server certificate CN fieldcheck"
        default y
        help
            This allows you to skip the validation of OTA server certificate CN field.

    config EXAMPLE_OTA_RECV_TIMEOUT_MS
        int "OTA Receive Timeout"
        default 5000
        help
            Maximum time for reception

    config EXAMPLE_OTA_UPDATE_INTERVAL_MS
        int "OTA Update Interval"
        default 1000
        help
            Interval between updates of OTA size to BLE Client

endmenu
```
